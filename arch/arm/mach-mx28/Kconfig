## arch/arm/mach-mx28/Kconfig
```kconfig
config MODULE_CCARDXMX28
	bool

choice
	prompt "Select i.MXS board type"

config MACH_MX28EVK
	bool "Freescale MX28 EVK board"
	depends on ARCH_MX28
	select USB_ARCH_HAS_EHCI

config MACH_CPX2
	bool "Digi International ConnectPort X2"
	depends on ARCH_MX28
	select USB_ARCH_HAS_EHCI

config MACH_CCARDWMX28JS
	bool "Digi International ConnectCard Wi-i.MX28 on JSK development board"
	depends on ARCH_MX28
	select USB_ARCH_HAS_EHCI
	select MODULE_CCARDXMX28

config MACH_CCARDMX28JS
	bool "Digi International ConnectCard i.MX28 on JSK development board"
	depends on ARCH_MX28
	select USB_ARCH_HAS_EHCI
	select MODULE_CCARDXMX28

config MACH_WR21
	bool "Digi International TransPort WR21"
	depends on ARCH_MX28
	select USB_ARCH_HAS_EHCI
endchoice

choice
	prompt "Select development board variant:"
	depends on MODULE_CCARDXMX28
	default JSCCARDXMX28_V2

config JSCCARDXMX28_V1
	bool "ConnectCard for i.MX28 Development Board V1"
	help
	  Select this option if you have Version 1 of the Development Board.
	  PCB S/N 30013792-01

config JSCCARDXMX28_V2
	bool "ConnectCard for i.MX28 Development Board V2"
	help
	  Select this option if you have Version 2 of the Development Board.
	  PCB S/N 30013792-02

endchoice

config MTD_DIGI_REMOVE_DEFAULT_FREESCALE_PARTITION
	bool "Remove the default boot partition created by Freescale"
	depends on ARCH_MX28
	default y if MACH_CPX2 || MODULE_CCARDXMX28 || MACH_WR21
	default n
	help
	  You should select yes unless you know what you are doing.  We normally
	  use kernel command line arguments to set the NAND partition information.
	  However, the Freescale platform code creates a 20 Megabyte boot partition
	  by default, and this will interfere with the partition settings on the
	  command line.  So if you want to set the NAND partitions on the kernel
	  command line, then set this option to y.
	  Enable this for Digi International platforms.

config NO_OTP_MAC_ADDRESS
	bool "Do not read FEC MAC address from OTP bits"
	depends on ARCH_MX28
	default y if MACH_CPX2 || MODULE_CCARDXMX28 || MACH_WR21
	default n
	help
	  Enabling this option disregards OTP bits (e-fuses) reserved to store
	  the MAC address of the FEC. Instead, the MAC will be set by U-Boot or
	  by the kernel command line with "fec_mac=...".

config VECTORS_PHY_ADDR
	int "vectors address"
	default 0
	help
	  This config set vectors table is located which physical address

config MXS_TIMER_WITH_MACH
	bool "System Timer support Compare Match interrupt"
	default y

config MXS_RAM_FREQ_SCALING
        bool "RAM frequency scaling support"
        depends on ARCH_MXS
        default y

choice
	prompt "Select MXS RAM chip"
	depends on MXS_RAM_FREQ_SCALING

config MXS_RAM_MDDR
	bool "mDDR SDRAM"
	depends on ARCH_MX23
config MXS_RAM_DDR
	bool "DDR SDRAM"
	depends on ARCH_MX23

endchoice

config IRAM_ALLOC
        bool
        default y
        select GENERIC_ALLOCATOR

config MEM_mDDR
	bool "Memory type is mDDR"
	depends on ARCH_MX28
	help
	  Say Y to select mDDR memory

menu "CAN Port Options"
	depends on CAN_FLEXCAN && MODULE_CCARDXMX28

config CCMX28_CAN0
	bool "Enable CAN0 port"
	default y
	help
	  Enables port CAN0 of the CPU

config CCMX28_CAN1
	bool "Enable CAN1 port"
	default y
	help
	  Enables port CAN1 of the CPU

endmenu

menu "Ethernet Options"
	depends on MODULE_CCARDXMX28 && FEC

config CCARDXMX28_ENET0_LEDS
	bool "Ethernet 0 LEDs"
	depends on !MXS_AUART0_4WIRE
	default n
	help
	  Ethernet 0 Link and Activity LEDs

config CCARDXMX28_ENET1
	bool "Second Ethernet (ENET1)"
	default y
	help
	  Enables FEC interface ENET1

config CCARDXMX28_ENET1_LEDS
	bool "Ethernet 1 LEDs"
	depends on CCARDXMX28_ENET1 && !MXS_AUART3_DEVICE_ENABLE
	default n
	help
	  Ethernet 1 Link and Activity LEDs

endmenu
```
